/dts-v1/;
/plugin/;

#include "pineapplep-hdk.dtsi"

/ {
	model = "Qualcomm Technologies, Inc. PineappleP HDK";
	compatible = "qcom,pineapplep-hdk", "qcom,pineapplep", "qcom,hdk";
	qcom,msm-id = <577 0x20000>, <702 0x20000>;
	qcom,board-id = <0x1f 0>;
};

&soc {
        pcie1_pwr: pcie1_pwr {
                compatible = "regulator-fixed";
                regulator-name = "pcie1_pwr";
                gpio = <&tlmm 3 0>;
                regulator-min-microvolt = <1800000>;
                regulator-max-microvolt = <1800000>;
                regulator-always-on;
                regulator-boot-on;
                enable-active-high;
                regulator-enable-ramp-delay = <5000>;
        };
};

&pcie1 {
	msi-map = <0x0 &gic_its 0x1480 0x1>,
		<0x100 &gic_its 0x1481 0x1>; /* 32 event IDs */
        dummy-supply = <&pcie1_pwr>;
        qcom,iommu-dma = "atomic";
};
